## ESP32/conexiones/tcp_socket/Kconfig.projbuild
```kconfig
menu "TCP Configuration"

    config ESP_TCP_IPV4_ADDR
        string "IPV4 Address"
        default "192.168.0.165"
        help
            The example will connect to this IPV4 address.

    config ESP_TCP_PORT
        int "Port"
        range 0 65535
        default 3333
        help
            The remote port to which the client example will connect to.

endmenu
```

## ESP32/conexiones/udp_socket/Kconfig.projbuild
```kconfig
menu "UDP Configuration"

    config ESP_UDP_IPV4_ADDR
        string "IPV4 Address"
        default "192.168.0.165"
        help
            IPV4 address to which the client example will send data.

    config ESP_UDP_PORT
        int "Port"
        range 0 65535
        default 3333
        help
            The remote port to which the client example will send data.

endmenu
```

## T2ESP32/main/Kconfig.projbuild
```kconfig
menu "Device Configuration"

    config ESP_DEVICE_NAME
        string "Device Name"
        default "ESP32_0"
        help
            The name of the device. This name will be used as the
            hostname of the device in BLE.

endmenu
```
